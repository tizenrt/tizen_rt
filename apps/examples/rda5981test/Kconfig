## apps/examples/rda5981test/Kconfig
```kconfig
#
# For a description of the syntax of this configuration file,
# see kconfig-language at https://www.kernel.org/doc/Documentation/kbuild/kconfig-language.txt
#

config RDA5981_TEST
	bool "\"Hello, World!\" example in tash"
	default n
	depends on TASH
	---help---
		Enable the \"Hello, World!\" example in tash

if RDA5981_TEST

config RDA5981_TEST_PROGNAME
	string "Program name"
	---help---
		This is the name of the program that will be use when the NSH ELF
		program is installed.

endif

config USER_ENTRYPOINT
	string
```

## os/arch/arm/src/rda5981/Kconfig
```kconfig
#
# For a description of the syntax of this configuration file,
# see kconfig-language at https://www.kernel.org/doc/Documentation/kbuild/kconfig-language.txt
#

comment "RDA 5981 Chip Configuration Options"

choice
	prompt "RDA Chip Selection"
	default ARCH_CHIP_RDA5981C

config ARCH_CHIP_RDA5981C
	bool "RDA5981C"
	select ARCH_CORTEXM4
    
endchoice

config RDA5981_GPIO
	bool "RDA5981 GPIO support"
    select rda5981_PINMAP
	default n

config RDA5981_RTC
	bool "RDA5981 RTC support"
	default n

config RDA5981_UART
	bool "RDA5981 UART support"
	default n

config RDA5981_PWR
	bool "RDA5981 PWR support"
	default n
```

## os/arch/arm/src/rda5981_board/Kconfig
```kconfig
#
# For a description of the syntax of this configuration file,
# see kconfig-language at https://www.kernel.org/doc/Documentation/kbuild/kconfig-language.txt
#

if ARCH_BOARD_RDA5981



config RDA5981_PWM_CHNUM
    int "Number of PWM channel"
    default 6

    ---help---
        Sets the number of pwm channel exposed RDA5981C
        evaluation board


choice
	bool "Build for qemu hardware"
	default QEMU_NONE

config QEMU_SRAM
	bool "Build for SRAM increased QEMU Hardware"
	---help---
		Build for SRAM increased QEMU Hardware.

config QEMU_SDRAM
	bool "Build for SDRAM(External RAM) enabled QEMU Hardware"
	---help---
		Build for SDRAM(External RAM) enabled QEMU Hardware.

config QEMU_NONE
	bool "NONE"
	---help---
		Dont build for Qemu Hardware.
endchoice
endif
```

## os/drivers/wireless/rda_wifi/Kconfig
```kconfig
menuconfig RDA_WLAN
	bool "RDA Wireless Module support"
	default n
	select SPI

if RDA_WLAN

config RDA_RX_PERFORMANCE_TEST
	bool "Enable UDP RX performance test"
        default n
	---help---
	  This option enables RX UDP performance measurement without
	  involving the LWIP stack

config RDA_TX_FLOW_CONTROL
	bool "Enable TX flow control"
        default n
	---help---
	  This option enables TX flow control

config RDA_ENABLE_PORT_CONTROL
	bool "Enable controlled/uncontrolled port logic in the driver"
	default y
	---help---
	  This option enables controlled/uncontrolled port logic in the driver

config RDA_WLAN_STA_ONLY
	bool "Support WLAN STA only (no P2P/AP/IBSS)"
	default n
	---help---
	  Enable only basic STA mode for debugging purposes

config RDA_WLAN_BLOCK_IPV6
	bool "Block IPv6"
	default n
	---help---
	  This option blocks IPv6 packets.

config RDA_WLAN_UDP_FLOWCONTROL
	bool "Enable UDP Flow Control by changing LPWORK priority"
	default n
	---help---
	  This option enables when iperf UDP Rx packet drops exist
	  when mbox has been full, LPWORK drops its priority

config RDA_WLAN_AUTO_RECOVERY
	bool "Enable Auto Recovery"
	default n
	---help---
	  Enables auto recovery on FW panic and RDA driver watch dog timeouts,
	  which will reset subsystem and re-enable state.

config RDA_WLAN_POWER_SAVE
        bool "Enable Power Save mode"
        default y
        ---help---
          This option enables driver to configure power save mode in
          firmware.

config RDA_WLAN_MAX_INTERFACES
	int "Max number of virtual interfaces supported"
	default 1
	---help---
	  The driver structures are sized to support this
	  number of interfaces.

endif

menuconfig RDA_CORE
	bool "RDA Core driver Module support"
	default n
	select SPI

if RDA_CORE

config RDA_PLATFORM
	bool "Samsung RDA MIF Platform driver implementation"
	default n

config RDA_WLANLITE
	bool "Samsung RDA WLANLITE driver mode"
	default n

config RDA_DISABLE_WLAN_RESET
	bool "Never power down the Samsung RDA WLAN CPU"
	default n

endif
```
